#include "wispor.dtsi"

&kscan0 {
    row-gpios
        = <&pro_micro  2 (GPIO_ACTIVE_HIGH | GPIO_PULL_DOWN)> // P0.17
        , <&pro_micro  5 (GPIO_ACTIVE_HIGH | GPIO_PULL_DOWN)> // P0.24
        , <&pro_micro  8 (GPIO_ACTIVE_HIGH | GPIO_PULL_DOWN)> // P1.04
        , <&pro_micro 10 (GPIO_ACTIVE_HIGH | GPIO_PULL_DOWN)> // P0.09
        ;

    col-gpios
        = <&pro_micro 16 (GPIO_ACTIVE_HIGH | GPIO_PULL_DOWN)> // P0.10
        , <&pro_micro  9 (GPIO_ACTIVE_HIGH | GPIO_PULL_DOWN)> // P1.06
        , <&pro_micro  7 (GPIO_ACTIVE_HIGH | GPIO_PULL_DOWN)> // P0.11
        , <&pro_micro  6 (GPIO_ACTIVE_HIGH | GPIO_PULL_DOWN)> // P1.00
        , <&pro_micro  4 (GPIO_ACTIVE_HIGH | GPIO_PULL_DOWN)> // P0.22
        , <&pro_micro  3 (GPIO_ACTIVE_HIGH | GPIO_PULL_DOWN)> // P0.20
        ;
};