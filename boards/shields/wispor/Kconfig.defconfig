## boards/shields/wispor/Kconfig.defconfig
```kconfig
# General Config
if SHIELD_WISPOR_LEFT || SHIELD_WISPOR_RIGHT

    config ZMK_SPLIT
        default y

endif

# Left half config
if SHIELD_WISPOR_LEFT

    config ZMK_KEYBOARD_NAME
        default "Wispor"

    config ZMK_SPLIT_ROLE_CENTRAL
        default y

endif
```

## boards/shields/wispor/Kconfig.shield
```kconfig
config SHIELD_WISPOR_LEFT
    def_bool $(shields_list_contains,wispor_left)

config SHIELD_WISPOR_RIGHT
    def_bool $(shields_list_contains,wispor_right)
```
